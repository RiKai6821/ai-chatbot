## firmware-idf/components/bsp_display/Kconfig
```kconfig
# 共享组件配置：GC9A01 圆屏 SPI 引脚。
menu "BSP 显示（GC9A01 圆屏 SPI 引脚）"

    config XZ_TFT_SCLK
        int "TFT SCLK GPIO"
        default 12
    config XZ_TFT_MOSI
        int "TFT MOSI (SDA) GPIO"
        default 11
    config XZ_TFT_DC
        int "TFT DC GPIO"
        default 8
    config XZ_TFT_CS
        int "TFT CS GPIO"
        default 10
    config XZ_TFT_RST
        int "TFT RST GPIO"
        default 9
    config XZ_TFT_BL
        int "TFT 背光 BL GPIO（高电平亮）"
        default 14

endmenu
```

## firmware-idf/components/bsp_wifi/Kconfig
```kconfig
# 共享组件配置：WiFi 凭据（menuconfig 里改，不入版本库）。
menu "BSP WiFi"

    config XZ_WIFI_SSID
        string "WiFi SSID"
        default "your-wifi-2.4G"
        help
            ESP32 多数只支持 2.4GHz。

    config XZ_WIFI_PASSWORD
        string "WiFi 密码"
        default "your-password"

endmenu
```

## firmware-idf/esp32_audio/main/Kconfig.projbuild
```kconfig
menu "小智 音频配置（I2S 引脚 / 采样率）"

    config XZ_SAMPLE_RATE
        int "采样率 (Hz)"
        default 16000
        help
            录音/播放统一采样率，16kHz 与服务端一致。

    comment "INMP441 麦克风（I2S0 接收）"
    config XZ_MIC_BCLK
        int "MIC BCLK GPIO"
        default 4
    config XZ_MIC_WS
        int "MIC WS (LRCL) GPIO"
        default 5
    config XZ_MIC_DIN
        int "MIC SD (数据输入) GPIO"
        default 6

    comment "MAX98357A 功放（I2S1 发送）"
    config XZ_SPK_BCLK
        int "SPK BCLK GPIO"
        default 15
    config XZ_SPK_WS
        int "SPK LRC (WS) GPIO"
        default 16
    config XZ_SPK_DOUT
        int "SPK DIN (数据输出) GPIO"
        default 7

endmenu
```

## firmware-idf/esp32_chat/main/Kconfig.projbuild
```kconfig
# 本应用配置（WiFi 凭据在共享组件 bsp_wifi 的菜单里）。
menu "小智 Chat 配置"

    config XZ_SERVER_URL
        string "服务端 /chat 地址"
        default "http://192.168.1.10:8000/chat"
        help
            你电脑的局域网 IP；服务端启动要带 --host 0.0.0.0。

    config XZ_SESSION_ID
        string "会话 ID"
        default "esp32-idf-1"

endmenu
```

## firmware-idf/esp32_chat/sdkconfig.defaults
```kconfig
# 工程默认配置（首次 build 会据此生成 sdkconfig）。
# 放开主任务栈，给 HTTP/JSON 留余量。
CONFIG_ESP_MAIN_TASK_STACK_SIZE=8192

# 目标芯片：ESP32-S3
CONFIG_IDF_TARGET="esp32s3"

# 日志等级 INFO
CONFIG_LOG_DEFAULT_LEVEL_INFO=y
```

## firmware-idf/esp32_voice_assistant/main/Kconfig.projbuild
```kconfig
# 本应用配置（WiFi 在 bsp_wifi、I2S 引脚在 bsp_audio 的菜单里）。
menu "小智 语音助手 配置"

    config XZ_VOICE_URL
        string "服务端 /voice 地址"
        default "http://192.168.1.10:8000/voice"
        help
            你电脑的局域网 IP；服务端启动要带 --host 0.0.0.0。

    config XZ_SESSION_ID
        string "会话 ID"
        default "esp32-voice-1"

    config XZ_RECORD_SECONDS
        int "每次按键录音时长 (秒)"
        default 4
        range 1 10

    config XZ_BTN_GPIO
        int "唤醒按键 GPIO（板载 BOOT 键为 0）"
        default 0

endmenu
```
